## conf/machine/arria10.conf
```bitbake
#@TYPE: Machine
#@NAME: arria10
#@DESCRIPTION: Machine configuration for the Arria 10 SoC" 

require conf/machine/include/socfpga.inc

UBOOT_MACHINE = "socfpga_arria10_defconfig"
PREFERRED_VERSION_u-boot-socfpga = "2014.10"
EXTRA_IMAGECMD_jffs2 = "--squash -s 256 -e 64KiB"
```

## conf/machine/cyclone5-mercury-sa1.conf
```bitbake
#@TYPE: Machine
#@NAME: cyclone5-mercury-sa1
#@DESCRIPTION: Machine configuration for the Cyclone V SoC based Enclustra
#              Mercury SA1" 

require conf/machine/include/socfpga.inc

KERNEL_PROVIDER = "enclustra-linux-altera"
PREFERRED_PROVIDER_virtual/kernel = "${KERNEL_PROVIDER}"

PREFERRED_VERSION_u-boot-socfpga = "2013.01.01"

UBOOT_MACHINE = "socfpga_cyclone5"

KERNEL_IMAGETYPE = "uImage"
```
